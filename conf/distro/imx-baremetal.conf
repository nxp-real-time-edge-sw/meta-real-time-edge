## conf/distro/include/rt-edge-base.inc
```bitbake
# RT Edge base conf

DISTRO = "nxp-rt-edge"
DISTROOVERRIDES = "rt-edge"
DISTRO_NAME = "NXP RT Edge Distro"
DISTRO_VERSION = "1.12"

DISTRO_FEATURES_remove_mx8 = "jailhouse "
DISTRO_FEATURES_append_ls1043ardb = " jailhouse-rt-edge"
DISTRO_FEATURES_append_ls1046ardb = " jailhouse-rt-edge"
DISTRO_FEATURES_append_ls1028ardb = " jailhouse-rt-edge libbee libblep libnfc-nci \
				      wayland-protocols weston imx-gpu-viv libdrm kmscube \
				      sysrepo-tsn tsn-scripts wayland"
DISTRO_FEATURES_append_mx8mp = " jailhouse-rt-edge sysrepo-tsn"
DISTRO_FEATURES_append_mx8m = " wayland-protocols weston imx-gpu-viv libdrm kmscube"
DISTRO_FEATURES_append_ls1028atsn = " sysrepo-tsn"
DISTRO_FEATURES_append_ls1021atsn = " sysrepo-tsn nodejs-lbt feedgnuplot tsn-scripts prl"
DISTRO_FEATURES_append_ls1021aiot = " canfestival"

#For ls1028ardb
DISTRO_FEATURES_remove_ls1028ardb = " x11"
PREFERRED_VERSION_weston_ls1028ardb = "9.0.0.imx"
PREFERRED_VERSION_wayland-protocols_ls1028ardb = "1.20.imx"
PREFERRED_VERSION_libdrm_ls1028ardb = "2.4.102.imx"
PREFERRED_PROVIDER_virtual/libgl_ls1028ardb  = "imx-gpu-viv"
PREFERRED_PROVIDER_virtual/libgles1_ls1028ardb  = "imx-gpu-viv"
PREFERRED_PROVIDER_virtual/libgles2_ls1028ardb  = "imx-gpu-viv"
PREFERRED_PROVIDER_virtual/egl_ls1028ardb  = "imx-gpu-viv"
LICENSE_FLAGS_WHITELIST_append_ls1028ardb = " commercial"

DELTA_KERNEL_DEFCONFIG_append = " \
    linux-rt.config \
"
DELTA_KERNEL_DEFCONFIG_append_mx8mm = " linux-fec.config"
DELTA_KERNEL_DEFCONFIG_append_mx8m = " linux-imx8.config"

SYSREPO_TSN_ls1028ardb = "sysrepo-tsn-tc"
SYSREPO_TSN_ls1028atsn = "sysrepo-tsn-tc"
SYSREPO_TSN_ls1021atsn = "sysrepo-tsn-tc"
SYSREPO_TSN_mx8mp = "sysrepo-tsn-tc"
PACKAGECONFIG_append_pn-sysrepo-tsn = "${SYSREPO_TSN}"

# dtb for jailhouse
KERNEL_DEVICETREE_append_ls1043ardb= " freescale/fsl-ls1043a-rdb-sdk-jailhouse.dtb"
KERNEL_DEVICETREE_append_ls1043ardb= " freescale/fsl-ls1043a-rdb-sdk-jailhouse-with-dpaa.dtb"
KERNEL_DEVICETREE_append_ls1046ardb= " freescale/fsl-ls1046a-rdb-sdk-jailhouse.dtb"
KERNEL_DEVICETREE_append_ls1046ardb= " freescale/fsl-ls1046a-rdb-sdk-jailhouse-with-dpaa.dtb"
KERNEL_DEVICETREE_append_ls1028ardb= " freescale/fsl-ls1028a-rdb-jailhouse.dtb"
KERNEL_DEVICETREE_append_imx8mpevk = " freescale/imx8mp-evk-root.dtb"
```

## conf/distro/include/rtos-industrial-examples.inc
```bitbake
# arm gcc toolchain
# ARMGCC_DIR ?= "${DEPLOY_DIR_IMAGE}/arm-none-eabi"

# board name
RTOS-INDUSTRIAL-BOARD ?= ""
RTOS-INDUSTRIAL-BOARD:mx8mm-nxp-bsp = "evkmimx8mm"
# RTOS-INDUSTRIAL-BOARD:mx8mn-nxp-bsp = "evkmimx8mn"
RTOS-INDUSTRIAL-BOARD:mx8mp-nxp-bsp = "evkmimx8mp"
# RTOS-INDUSTRIAL-BOARD:mx8mq-nxp-bsp = "evkmimx8mq"
RTOS-INDUSTRIAL-BOARD:imx93evk = "mcimx93evk"
RTOS-INDUSTRIAL-BOARD:imx93-9x9-lpddr4-qsb = "mcimx93qsb"
RTOS-INDUSTRIAL-BOARD:imx93-14x14-lpddr4x-evk = "mcimx93autoevk"
RTOS-INDUSTRIAL-BOARD:imx95-15x15-lpddr4x-evk = "imx95lpd4xevk15"
RTOS-INDUSTRIAL-BOARD:imx95-19x19-lpddr5-evk = "imx95lpd5evk19"
RTOS-INDUSTRIAL-BOARD:imx91-9x9-lpddr4-qsb = "mcimx91qsb"
RTOS-INDUSTRIAL-BOARD:imx91-11x11-lpddr4-evk = "mcimx91evk"
RTOS-INDUSTRIAL-BOARD:mx943-nxp-bsp = "imx943evk"

# board name for heterogeneous multicore examples
RTOS-INDUSTRIAL-BOARD-CA:mx8mm-nxp-bsp = "evkmimx8mm_ca53"
RTOS-INDUSTRIAL-BOARD-CA:mx8mp-nxp-bsp = "evkmimx8mp_ca53"
RTOS-INDUSTRIAL-BOARD-CA:imx93evk = "mcimx93evk_ca55"
RTOS-INDUSTRIAL-BOARD-CA:imx93-14x14-lpddr4x-evk = "mcimx93evk_ca55"
RTOS-INDUSTRIAL-BOARD-CA:imx95-15x15-lpddr4x-evk = "mcimx95evk_ca55"
RTOS-INDUSTRIAL-BOARD-CA:imx95-19x19-lpddr5-evk = "mcimx95evk_ca55"
RTOS-INDUSTRIAL-BOARD-CA:imx91-9x9-lpddr4-qsb = "mcimx91qsb_ca55"
RTOS-INDUSTRIAL-BOARD-CA:imx91-11x11-lpddr4-evk = "mcimx91evk_ca55"

RTOS-INDUSTRIAL-BOARD-CM:mx8mm-nxp-bsp = "evkmimx8mm_cm4"
RTOS-INDUSTRIAL-BOARD-CM:mx8mp-nxp-bsp = "evkmimx8mp_cm7"
RTOS-INDUSTRIAL-BOARD-CM:imx93evk = "mcimx93evk_cm33"
RTOS-INDUSTRIAL-BOARD-CM:imx93-14x14-lpddr4x-evk = "mcimx93evk_cm33"

python () {
    if d.getVar('RTOS-INDUSTRIAL-BOARD', True):
        d.appendVar('DISTRO_FEATURES', " rtos-industrial" )
}

EXAMPLE_TARGET_TYPE = " \
    release \
    ddr_release \
"
```

## conf/distro/nxp-baremetal.conf
```bitbake
require conf/distro/nxp-rt-edge.conf

BAREMETAL-ENV_imx = "conf/distro/include/imx-baremetal-env.inc"
BAREMETAL-ENV_qoriq = "conf/distro/include/qoriq-baremetal-env.inc"
include ${BAREMETAL-ENV}

DISTRO = "nxp-baremetal"

DISTRO_FEATURES_append = " baremetal"

IMAGE_BOOT_FILES += " bm-u-boot*.bin"
```

## conf/distro/nxp-real-time-edge-baremetal.conf
```bitbake
require conf/distro/nxp-real-time-edge.conf
require conf/distro/include/${NXP-PLATFORM}-baremetal-env.inc

DISTRO = "nxp-real-time-edge-baremetal"

DISTRO_FEATURES:append = " baremetal"
DISTROOVERRIDES:append = ":baremetal"

IMAGE_BOOT_FILES += " bm-u-boot*.bin"
```

## conf/distro/nxp-real-time-edge-emmc.conf
```bitbake
require conf/distro/nxp-real-time-edge.conf

DISTRO = "nxp-real-time-edge-emmc"
DISTROOVERRIDES:append = ":emmc-boot"
```

## conf/distro/nxp-real-time-edge-plc.conf
```bitbake
NXP-PLATFORM ?= "imx"
NXP-PLATFORM:qoriq = "qoriq"

include conf/distro/include/fsl-imx-base.inc
include conf/distro/include/fsl-imx-preferred-env.inc
include conf/distro/include/real-time-edge-base.inc
include conf/distro/include/igh-ethercat.inc
include conf/distro/include/libopen62541.inc

# Remove conflicting backends
DISTRO_FEATURES:remove = "directfb x11 systemd"

# System Manager config
SYSTEM_MANAGER_CONFIG:imx95-19x19-lpddr5-evk = "mx95rte"
SYSTEM_MANAGER_CONFIG:imx95-15x15-lpddr4x-evk = "mx95rte"

# boot image config
IMAGE_IMXBOOT_TARGET:imx95-19x19-lpddr5-evk = "${IMXBOOT_TARGETS_BASENAME}_a55"
IMAGE_IMXBOOT_TARGET:imx95-15x15-lpddr4x-evk = "${IMXBOOT_TARGETS_BASENAME}_a55"

DISTROOVERRIDES:append = ":real-time-edge-plc"

POKY_INIT_MANAGER:real-time-edge-plc = "sysvinit"

# enable mdev/busybox for init

DISTRO_FEATURES:append = " sysvinit"

DISTRO_FEATURES_BACKFILL_CONSIDERED:append = " systemd"

VIRTUAL-RUNTIME_init_manager = "sysvinit"

VIRTUAL-RUNTIME_initscripts = "initscripts"

#VIRTUAL-RUNTIME_keymaps = "keymaps"

VIRTUAL-RUNTIME_login_manager = "busybox"

DELTA_KERNEL_DEFCONFIG:append:mx6ull-nxp-bsp = " imx6ullevk-plc.config"

DISTRO = "nxp-real-time-edge-plc"
```

## conf/distro/nxp-real-time-edge.conf
```bitbake
NXP-PLATFORM ?= "imx"
NXP-PLATFORM:qoriq = "qoriq"

require conf/distro/include/${NXP-PLATFORM}-real-time-edge-env.inc

DISTRO = "nxp-real-time-edge"
DISTRO_VERSION = "2.5"
```

## conf/distro/nxp-rt-edge.conf
```bitbake
RT-EDGE-ENV_imx = "conf/distro/include/imx-rt-edge-env.inc"
RT-EDGE-ENV_qoriq = "conf/distro/include/qoriq-rt-edge-env.inc"

include ${RT-EDGE-ENV}

DISTRO = "nxp-rt-edge"
DISTRO_VERSION = "2.0"
```

## conf/distro/qoriq-baremetal.conf
```bitbake
require conf/distro/qoriq-rt-edge.conf
include conf/distro/include/qoriq-baremetal-env.inc

DISTRO = "qoriq-baremetal"

DISTRO_FEATURES_append = " baremetal"

IMAGE_BOOT_FILES += " bm-u-boot*.bin"
```

## conf/distro/qoriq-industrial.conf
```bitbake
require conf/distro/fsl-qoriq.conf
include conf/distro/include/industrial-base.inc
include conf/machine/include/qoriq-wks-base.inc

DISTRO = "qoriq-industrial"
```

## conf/distro/qoriq-rt-edge.conf
```bitbake
require conf/distro/poky.conf
include conf/distro/include/rt-edge-base.inc
include conf/machine/include/qoriq-wks-base.inc
include conf/distro/include/libopen62541.inc

DISTRO = "qoriq-rt-edge"
MAINTAINER = "Freescale Yocto Team <meta-freescale@yoctoproject.org>"

TARGET_VENDOR = "-fsl"

SDK_VENDOR = "-fslsdk"
SDK_NAME_PREFIX = "${DISTRO}"

POKY_DEFAULT_DISTRO_FEATURES_remove = " ptest"
DISTRO_FEATURES_append = " opengl pam virtualization polkit ipv6"

LICENSE_FLAGS_WHITELIST = "non-commercial_netperf"

MKUBIFS_ARGS = "-m 512 -e 15360 -c 13000"
UBINIZE_ARGS = "-m 512 -p 16KiB -s 512"

PREFERRED_PROVIDER_qemu = "qemu-qoriq"

PREFERRED_VERSION_virtual/nativesdk-libiconv = "2.20"
PREFERRED_VERSION_tcpreplay = "3.4.4"
PREFERRED_PROVIDER_virtual/kernel = "linux-qoriq"
LTTNGUST_qoriq = ""
LTTNGTOOLS_qoriq = ""
LTTNGMODULES_qoriq = ""
MACHINE_HAS_VIVANTE_KERNEL_DRIVER_SUPPORT = "1"

SOC_DEFAULT_IMAGE_FSTYPES_append = " wic.bmap wic.bz2 tar.bz2"
SOC_DEFAULT_IMAGE_FSTYPES_remove = " tar.gz ext2.gz.u-boot ext2.gz"
```

## conf/layer.conf
```bitbake
# We have a conf and classes directory, add to BBPATH
BBPATH .= ":${LAYERDIR}"

# We have recipes-* directories, add to BBFILES
BBFILES += "${LAYERDIR}/recipes-*/*/*.bb \
            ${LAYERDIR}/recipes-*/*/*.bbappend"

BBFILE_COLLECTIONS += "meta-real-time-edge"
BBFILE_PATTERN_meta-real-time-edge = "^${LAYERDIR}/"
BBFILE_PRIORITY_meta-real-time-edge = "9"
LAYERSERIES_COMPAT_meta-real-time-edge = "mickledore nanbield scarthgap walnascar"

# Create a mirror for unreliable packages
MIRRORS += "http://sourceforge.net/.* http://www.nxp.com/lgfiles/updates/other"

# FIXME: Drop these lines when the external layers are marked compatible
LAYERSERIES_COMPAT_chromium-browser-layer:append = " langdale mickledore scarthgap walnascar"

# Define new EULAs and add them to the list defined in meta-freescale.
# See fsl-eula-unpack.bbclass.
FSL_EULA_FILE_MD5SUM_LA_OPT_NXP_SOFTWARE_LICENSE_V62 = "a93b654673e1bc8398ed1f30e0813359"
FSL_EULA_FILE_MD5SUM_LA_OPT_NXP_SOFTWARE_LICENSE_V63 = "bc649096ad3928ec06a8713b8d787eac"

FSL_EULA_FILE_MD5SUMS:append = " \
    ${FSL_EULA_FILE_MD5SUM_LA_OPT_NXP_SOFTWARE_LICENSE_V62} \
    ${FSL_EULA_FILE_MD5SUM_LA_OPT_NXP_SOFTWARE_LICENSE_V63} \
"

BBFILES_DYNAMIC += " \
    fsl-bsp-release:${LAYERDIR}/dynamic-layers/imx-layer/*/*/*.bb \
    fsl-bsp-release:${LAYERDIR}/dynamic-layers/imx-layer/*/*/*.bbappend \
    qoriq-bsp-release:${LAYERDIR}/dynamic-layers/qoriq-layer/*/*/*.bb \
    qoriq-bsp-release:${LAYERDIR}/dynamic-layers/qoriq-layer/*/*/*.bbappend \
"
```

## conf/machine/imx8mp-rfnm.conf
```bitbake
#@TYPE: Machine
#@NAME: NXP i.MX 8M Plus RFNM with LPDDR4
#@SOC: i.MX8MP
#@DESCRIPTION: Machine configuration for NXP i.MX 8M Plus RFNM board with LPDDR4
#@MAINTAINER: Pramod Kumar <pramod.kumar_1@nxp.com>

MACHINEOVERRIDES =. "imx8mp-rfnm:"
require conf/machine/imx8mp-lpddr4-evk.conf

# The device tree name is implicit for RFNM, so can't use MACHINE here
KERNEL_DEVICETREE_BASENAME = "imx8mp-rfnm"

# NXP kernel has additional DTB files for various board configuration and
# derivates. Include them here for NXP BSP only
KERNEL_DEVICETREE += " \
	freescale/imx8mp-rfnm.dtb \
"

#UBOOT_CONFIG_BASENAME = "imx8mp_rfnm"
#UBOOT_CONFIG[fspi] = "${UBOOT_CONFIG_BASENAME}_defconfig"
#UBOOT_CONFIG[ndm]  = "${UBOOT_CONFIG_BASENAME}_ndm_defconfig"
```

## conf/machine/imx8mp-sdr.conf
```bitbake
#@TYPE: Machine
#@NAME: NXP i.MX 8M Plus SDR with LPDDR4
#@SOC: i.MX8MP
#@DESCRIPTION: Machine configuration for NXP i.MX 8M Plus SDR board with LPDDR4
#@MAINTAINER: Pramod Kumar <pramod.kumar_1@nxp.com>

MACHINEOVERRIDES =. "imx8mp-sdr:"
require conf/machine/imx8mp-lpddr4-evk.conf

# The device tree name is implicit for SDR, so can't use MACHINE here
KERNEL_DEVICETREE_BASENAME = "imx8mp-sdr"

# NXP kernel has additional DTB files for various board configuration and
# derivates. Include them here for NXP BSP only
KERNEL_DEVICETREE += " \
	freescale/imx8mp-sdr.dtb \
"

UBOOT_CONFIG_BASENAME = "imx8mp_sdr"
UBOOT_CONFIG[fspi] = "${UBOOT_CONFIG_BASENAME}_defconfig"
UBOOT_CONFIG[ndm]  = "${UBOOT_CONFIG_BASENAME}_ndm_defconfig"
```

## conf/machine/imx8mp-seeve.conf
```bitbake
#@TYPE: Machine
#@NAME: NXP i.MX 8M Plus SEEVE 4x4 with LPDDR4
#@SOC: i.MX8MP
#@DESCRIPTION: Machine configuration for NXP i.MX 8M Plus SDR board with LPDDR4
#@MAINTAINER: Pramod Kumar <pramod.kumar_1@nxp.com>

MACHINEOVERRIDES =. "imx8mp-seeve:"
require conf/machine/imx8mp-lpddr4-evk.conf

# The device tree name is implicit for SEEVE, so can't use MACHINE here
KERNEL_DEVICETREE_BASENAME = "imx8mp-sdr"

# NXP kernel has additional DTB files for various board configuration and
# derivates. Include them here for NXP BSP only
KERNEL_DEVICETREE += " \
	freescale/imx8mp-seeve.dtb \
"

UBOOT_CONFIG_BASENAME = "imx8mp_sdr"
UBOOT_CONFIG[fspi] = "${UBOOT_CONFIG_BASENAME}_defconfig"
```

## conf/machine/include/qoriq-wks-base.inc
```bitbake
# short-description: Create eMMC/SD card image with a boot partition
#
# Offsets:
#   * RCW+PBI+BL2 at block 8
#   * PFE firmware at block 0x100
#   * FIP (BL31+BL32+BL33) at 0x800
#   * Env variables at 0x2800
#   * Secureboot headers at 0x3000
#   * DDR PHY FIP at 0x4000
#   * DPAA1 FMAN ucode at 0x4800
#   * DPAA2-MC at 0x5000
#   * DPAA2 DPL at 0x6800
#   * DPAA2 DPC at 0x7000
#   * Device tree (UEFI) at 0x7800
#   * Kernel at 0x8000
#   * Ramdisk at 0x10000
#
# The disk layout (in blocks) used is:
#  blocks                           KiB
#     0x0 +-----------------------+    0x0
#         | MBR / GPT ...         |
#     0x8 +-----------------------+    0x4a
#         | RCW + PBI + BL2       |
#   0x100 +-----------------------+   0x80
#         | PFE firmware          |
#   0x800 +-----------------------+  0x400
#         | FIP (BL31+BL32+BL33)  |
#  0x2800 +-----------------------+ 0x1400
#         | U-Boot Env variables  |
#  0x3000 +-----------------------+ 0x1800
#         | Secureboot headers    |
#  0x4000 +-----------------------+ 0x2000
#         | DDR PHY FIP           |
#  0x4800 +-----------------------+ 0x2400
#         | DPAA1 FMAN ucode      |
#  0x5000 +-----------------------+ 0x2800
#         | DPAA2-MC              |
#  0x6800 +-----------------------+ 0x3400
#         | DPAA2 DPL             |
#  0x7000 +-----------------------+ 0x3800
#         | DPAA2 DPC             |
#  0x7800 +-----------------------+ 0x3c00
#         | Device tree (UEFI)    |
#  0x8000 +-----------------------+ 0x4000
#         | Kernel                |
# 0x10000 +-----------------------+ 0x8000
#         | Ramdisk               |
#         +-----------------------+
#

# offset(1K) number in beginning 64MB space of SD/eMMC card on all QorIQ platforms

SD_PBL_OFFSET  ?= "4"
SD_FIP_OFFSET  ?= "1024"
SD_UBOOT_ENV_OFFSET  ?= "5120"
SD_SECUREBOOT_HEADERS_OFFSET  ?= "6144"
SD_DDR_PHY_FW_OFFSET  ?= "8192"
SD_FUSE_HEADERS_OFFSET  ?= "8704"
SD_FMAN_UCODE_OFFSET  ?= "9216"
SD_QE_FIRMWARE_OFFSET  ?= "9472"
SD_DP_FIRMWARE_OFFSET  ?= "9472"
SD_PHY_FIRMWARE_OFFSET  ?= "9728"
SD_UBOOT_SCR_OFFSET  ?= "9984"
SD_DPAA2_MC_FW_OFFSET  ?= "10240"
SD_DPAA2_MC_DPL_OFFSET  ?= "13312"
SD_DPAA2_MC_DPC_OFFSET  ?= "14336"
SD_DEVICE_TREE_OFFSET  ?= "15360"
SD_KERNEL_OFFSET  ?= "16384"
SD_KERNELITB_OFFSET  ?= "16384"
SD_RAMDISKRFS_OFFSET  ?= "17408"


PBL_FILE ?= "atf/bl2_sd.pbl"
FIP_FILE ?= "atf/fip_uboot.bin"
DDR_PYH_FILE ?= "ddr-phy/fip_ddr_all.bin"
FMAN_UCODE_FILE ?= ""
QE_DP_FILE ?= ""
ETH_PHY_FILE ?= "ls2-phy/cs4315-cs4340-PHY-ucode.txt"
MCFW_FILE ?= "mc_app/mc.itb"
DPL_FILE ?= ""
DPC_FILE ?= ""
ITB_FILE ?= ""

SOC_DEFAULT_IMAGE_FSTYPES += " wic.bmap wic.gz"

# Do not update fstab file when using wic images
WIC_CREATE_EXTRA_ARGS ?= "--no-fstab-update"

IMAGE_BOOT_FILES ?= " \
    ${KERNEL_IMAGETYPE} \
    *.dtb \
"

SOC_DEFAULT_WKS_FILE_fsl-lsch2 ?= "qoriq-lsch2.wks.in"
SOC_DEFAULT_WKS_FILE_fsl-lsch3 ?= "qoriq-lsch3.wks.in"

WKS_FILE ?= "${SOC_DEFAULT_WKS_FILE}"
```
