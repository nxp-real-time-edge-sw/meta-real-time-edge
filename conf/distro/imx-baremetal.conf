## conf/distro/imx-baremetal.conf
```bitbake
require conf/distro/imx-rt-edge.conf
include conf/distro/include/imx-baremetal-env.inc

DISTRO = "imx-baremetal"

# Remove conflicting backends
DISTRO_FEATURES_remove = "directfb x11 "
DISTRO_FEATURES_append = " wayland pam systemd"

DISTRO_FEATURES_append = " baremetal"

IMAGE_BOOT_FILES += " bm-u-boot*.bin"
```

## conf/distro/imx-industrial.conf
```bitbake
include conf/distro/include/fsl-imx-base.inc
include conf/distro/include/fsl-imx-preferred-env.inc
include conf/distro/include/industrial-base.inc
include conf/distro/include/igh-ethercat.inc

DISTRO = "imx-industrial"

# Remove conflicting backends
DISTRO_FEATURES_remove = "directfb x11 "
DISTRO_FEATURES_append = " wayland pam systemd"
```

## conf/distro/imx-rt-edge.conf
```bitbake
include conf/distro/include/fsl-imx-base.inc
include conf/distro/include/fsl-imx-preferred-env.inc
include conf/distro/include/rt-edge-base.inc
include conf/distro/include/igh-ethercat.inc

DISTRO = "imx-rt-edge"

# Remove conflicting backends
DISTRO_FEATURES_remove = "directfb x11 "
DISTRO_FEATURES_append = " wayland pam systemd"
```

## conf/distro/include/imx-baremetal-env.inc
```bitbake
# update kernel configuration
DELTA_KERNEL_DEFCONFIG:append:mx8m-nxp-bsp = " linux-baremetal.config"
DELTA_KERNEL_DEFCONFIG:append:mx93-nxp-bsp = " linux-baremetal-imx93.config"

# update baremetal dts
KERNEL_DEVICETREE:append:imx8mp-lpddr4-evk = " freescale/imx8mp-evk-baremetal.dtb"
KERNEL_DEVICETREE:append:imx8mm-lpddr4-evk = " freescale/imx8mm-evk-baremetal.dtb"
KERNEL_DEVICETREE:append:imx93evk = " freescale/imx93-11x11-evk-baremetal.dtb"
KERNEL_DEVICETREE:append:imx93-9x9-lpddr4-qsb = " freescale/imx93-9x9-qsb-baremetal.dtb"

# uboot env
UBOOT_BOOT_BAREMETAL_DEFCONFIG ?= ""

UBOOT_BOOT_BAREMETAL_DEFCONFIG:imx8mp-lpddr4-evk ?= "imx8mp_evk_baremetal_master_defconfig"
UBOOT_BOOT_BAREMETAL_DEFCONFIG:imx8mm-lpddr4-evk ?= "imx8mm_evk_baremetal_master_defconfig"
UBOOT_BOOT_BAREMETAL_DEFCONFIG:imx93evk ?= "imx93_11x11_evk_baremetal_master_defconfig"
UBOOT_BOOT_BAREMETAL_DEFCONFIG:imx93-9x9-lpddr4-qsb ?= "imx93_9x9_qsb_baremetal_master_defconfig"

UBOOT_CONFIG = "sd"
UBOOT_CONFIG[sd] = "${UBOOT_BOOT_BAREMETAL_DEFCONFIG},sdcard"
```

## conf/distro/include/imx-rt-edge-env.inc
```bitbake
include conf/distro/include/fsl-imx-base.inc
include conf/distro/include/fsl-imx-preferred-env.inc
include conf/distro/include/rt-edge-base.inc
include conf/distro/include/igh-ethercat.inc
include conf/distro/include/libopen62541.inc

# Remove conflicting backends
DISTRO_FEATURES_remove = "directfb x11 "
DISTRO_FEATURES_append = " wayland pam systemd"
```

## conf/distro/include/industrial-base.inc
```bitbake
# Industrial base conf

DISTRO = "nxp-industrial"
DISTROOVERRIDES = "industrial"
DISTRO_NAME = "NXP Industrial Distro"
DISTRO_VERSION = "1.12"

DISTRO_FEATURES_remove_mx8 = "jailhouse "
DISTRO_FEATURES_append_ls1043ardb = " jailhouse-industrial"
DISTRO_FEATURES_append_ls1046ardb = " jailhouse-industrial"
DISTRO_FEATURES_append_ls1028ardb = " jailhouse-industrial libbee libblep libnfc-nci"
DISTRO_FEATURES_append_mx8mp = " jailhouse-industrial"
```

## conf/distro/include/libopen62541.inc
```bitbake
# Copyright 2020-2021 NXP

# *************** BUILD_TYPE ***************
#   RelWithDebInfo :  -O2 optimization with debug symbols
#   Release        :  -O2 optimization without debug symbols
#   Debug          :  -O0 optimization with debug symbols
#   MinSizeRel     :  -Os optimization without debug symbols
LIBOPEN62541_BUILD_TYPE ??= "Release"

# *************** LOGLEVEL ***************
#  600: Fatal
#  500: Error
#  400: Warning
#  300: Info
#  200: Debug
#  100: Trace
LIBOPEN62541_LOGLEVE ??= "300"

# *************** UA_MULTITHREADING ***************
#  Level of multi-threading support.
#  0-99     : Multithreading support disabled.
#  100-199  : API functions marked with the UA_THREADSAFE-macro are protected
#             internally with mutexes. Multiple threads are allowed to call these
#             functions of the SDK at the same time without causing race conditions.
#             Furthermore, this level support the handling of asynchronous method
#             calls from external worker threads.
#  >=200    : Work is distributed to a number of internal worker threads.
#             Currently only used for mDNS discovery. (EXPERIMENTAL FEATURE! Expect bugs.)
LIBOPEN62541_MULTITHREADING ??= "200"

# *************** BUILD_EXAMPLES ***************
# Compile example servers and clients from examples.
# ON  : Enable
# OFF : Disable
LIBOPEN62541_BUILD_EXAMPLES ??= "ON"

# *************** BUILD_UNIT_TESTS ***************
# Compile unit tests.
# ON  : Enable
# OFF : Disable
LIBOPEN62541_BUILD_UNIT_TESTS ??= "OFF"


# *************** ENABLE_SUBSCRIPTIONS ***************
# Enable subscriptions.
# ON  : Enable
# OFF : Disable
LIBOPEN62541_ENABLE_SUBSCRIPTIONS ??= "ON"

# *************** ENABLE_SUBSCRIPTIONS_EVENTS ***************
# Enable the use of events for subscriptions.
# ON  : Enable
# OFF : Disable
LIBOPEN62541_ENABLE_SUBSCRIPTIONS_EVENTS  ??= "ON"

# ************** ENABLE_SUBSCRIPTIONS_ALARMS_CONDITIONS ********
# Enable the use of A&C for subscriptions.
# ON  : Enable
# OFF : Disable
LIBOPEN62541_ENABLE_SUBSCRIPTIONS_ALARMS_CONDITIONS  ??= "ON"

# ************** ENABLE_METHODCALLS ******************
# Enable the Method service set
# ON  : Enable
# OFF : Disable
LIBOPEN62541_ENABLE_METHODCALLS ??= "ON"

# ************* ENABLE_PARSING ***************
# Enable parsing human readable formats of builtin data types (Guid, NodeId, etc.).
# ON  : Enable
# OFF : Disable
LIBOPEN62541_ENABLE_PARSING ??= "ON"

# ************ ENABLE_NODEMANAGEMENT ****************
# Enable dynamic addition and removal of nodes at runtime.
# ON  : Enable
# OFF : Disable
LIBOPEN62541_ENABLE_NODEMANAGEMENT ??= "ON"

# *********** ENABLE_AMALGAMATION *********
# Compile a single-file release into the files open62541.c and open62541.h.
# ON  : Enable
# OFF : Disable
LIBOPEN62541_ENABLE_AMALGAMATION ??= "OFF"

# *********** ENABLE_IMMUTABLE_NODES ********
# Nodes in the information model are not edited but copied and replaced.
# ON  : Enable
# OFF : Disable
LIBOPEN62541_ENABLE_IMMUTABLE_NODES ??= "OFF"

# ********** ENABLE_COVERAGE *********
# Measure the coverage of unit tests.
# ON  : Enable
# OFF : Disable
LIBOPEN62541_ENABLE_COVERAGE ??= "ON"

# ********** ENABLE_DISCOVERY *********
# Enable Discovery Service (LDS).
# ON  : Enable
# OFF : Disable
LIBOPEN62541_ENABLE_DISCOVERY ??= "ON"

# ********** ENABLE_DISCOVERY_MULTICAST *********
# Enable Discovery Service with multicast support (LDS-ME).
# ON  : Enable
# OFF : Disable
LIBOPEN62541_ENABLE_DISCOVERY_MULTICAST ??= "ON"

# ********** ENABLE_DISCOVERY_SEMAPHORE *********
# Enable Discovery Semaphore support.
# ON  : Enable
# OFF : Disable
LIBOPEN62541_ENABLE_DISCOVERY_SEMAPHORE ??= "ON"

# ********** NAMESPACE_ZERO *********
# Namespace zero contains the standard-defined nodes. The full namespace
# zero may not be required for all applications.
# MINIMAL     :  A barebones namespace zero that is compatible with most clients.
#                But this namespace 0 is so small that it does not pass the CTT
#                (Conformance Testing Tools of the OPC Foundation).
# REDUCED    :  Small namespace zero that passes the CTT.
# FULL       :  Full namespace zero generated from the official XML definitions.
LIBOPEN62541_NAMESPACE_ZERO ??= "FULL"

# ********** ENABLE_TYPEDESCRIPTION *********
# Add the type and member names to the UA_DataType structure.
# ON  : Enable
# OFF : Disable
LIBOPEN62541_ENABLE_TYPEDESCRIPTION ??= "ON"

# ********** ENABLE_STATUSCODE_DESCRIPTIONS *********
# Compile the human-readable name of the StatusCodes into the binary.
# ON  : Enable
# OFF : Disable
LIBOPEN62541_ENABLE_STATUSCODE_DESCRIPTIONS ??= "ON"

# ********** ENABLE_FULL_NS0 *********
# Use the full NS0 instead of a minimal Namespace 0 nodeset UA_FILE_NS0 is used to
# specify the file for NS0 generation from namespace0 folder.
LIBOPEN62541_ENABLE_FULL_NS0 ??= ""

# ********** BUILD_SHARED_LIBS *******
# ON  : Enable
# OFF : Disable
LIBOPEN62541_BUILD_SHARED_LIBS ??= "ON"

# ********** BUILD_DEBUG *******
# Enable assertions and additional definitions not intended for production builds
# ON  : Enable
# OFF : Disable
LIBOPEN62541_BUILD_DEBUG ??= "OFF"

# ********** DEBUG_DUMP_PKGS *******
# Dump every package received by the server as hexdump format.
# ON  : Enable
# OFF : Disable
LIBOPEN62541_DEBUG_DUMP_PKG ??= "OFF"

# ********** PUBSUB *******
# Enable publish/subscribe
# ON  : Enable
# OFF : Disable
LIBOPEN62541_ENABLE_PUBSUB ??= "ON"

# ********** PUBSUB_ETH_UADP *******
# Enable publish/subscribe UADP over Ethernet
# ON  : Enable
# OFF : Disable
LIBOPEN62541_ENABLE_PUBSUB_ETH_UADP ??= "ON"

# ********** PUBSUB_ETH_RX_HW_TIMESTAMP *******
# Enable Enable getting Rx HW timestamp on Ethernet packet
# ON  : Enable
# OFF : Disable
LIBOPEN62541_ENABLE_PUBSUB_ETH_RX_HW_TIMESTAMP ??= "ON"


# ********** MALLOC_SINGLETON *******
# Use a global variable pointer for malloc (and free, ...) that can be switched at runtime
# ON  : Enable
# OFF : Disable
LIBOPEN62541_ENABLE_MALLOC_SINGLETON ??= "OFF"


EXTRA_OECMAKE:append:pn-libopen62541 = " \
	-DUA_ENABLE_MALLOC_SINGLETON=${LIBOPEN62541_ENABLE_MALLOC_SINGLETON} \
	-DUA_ENABLE_PUBSUB=${LIBOPEN62541_ENABLE_PUBSUB} \
	-DUA_ENABLE_PUBSUB_ETH_UADP=${LIBOPEN62541_ENABLE_PUBSUB_ETH_UADP} \
	-DUA_ENABLE_PUBSUB_ETH_RX_HW_TIMESTAMP=${LIBOPEN62541_ENABLE_PUBSUB_ETH_RX_HW_TIMESTAMP} \
	-DCMAKE_BUILD_TYPE=${LIBOPEN62541_BUILD_TYPE} \
	-DUA_LOGLEVEL=${LIBOPEN62541_LOGLEVE} \
	-DUA_MULTITHREADING=${LIBOPEN62541_MULTITHREADING} \
	-DUA_BUILD_UNIT_TESTS=${LIBOPEN62541_BUILD_UNIT_TESTS} \
	-DUA_ENABLE_SUBSCRIPTIONS=${LIBOPEN62541_ENABLE_SUBSCRIPTIONS} \
	-DUA_ENABLE_SUBSCRIPTIONS_EVENTS=${LIBOPEN62541_ENABLE_SUBSCRIPTIONS_EVENTS} \
	-DUA_ENABLE_SUBSCRIPTIONS_ALARMS_CONDITIONS=${LIBOPEN62541_ENABLE_SUBSCRIPTIONS_ALARMS_CONDITIONS} \
	-DUA_ENABLE_METHODCALLS=${LIBOPEN62541_ENABLE_METHODCALLS} \
	-DUA_ENABLE_PARSING=${LIBOPEN62541_ENABLE_PARSING} \
	-DUA_ENABLE_NODEMANAGEMENT=${LIBOPEN62541_ENABLE_NODEMANAGEMENT} \
	-DUA_ENABLE_AMALGAMATION=${LIBOPEN62541_ENABLE_AMALGAMATION} \
	-DUA_ENABLE_IMMUTABLE_NODES=${LIBOPEN62541_ENABLE_IMMUTABLE_NODES} \
	-DUA_ENABLE_COVERAGE=${LIBOPEN62541_ENABLE_COVERAGE} \
	-DUA_ENABLE_DISCOVERY=${LIBOPEN62541_ENABLE_DISCOVERY} \
	-DUA_ENABLE_DISCOVERY_MULTICAST=${LIBOPEN62541_ENABLE_DISCOVERY_MULTICAST} \
	-DUA_ENABLE_DISCOVERY_SEMAPHORE=${LIBOPEN62541_ENABLE_DISCOVERY_SEMAPHORE} \
	-DUA_NAMESPACE_ZERO=${LIBOPEN62541_NAMESPACE_ZERO} \
	-DUA_ENABLE_TYPEDESCRIPTION=${LIBOPEN62541_ENABLE_TYPEDESCRIPTION} \
	-DUA_ENABLE_STATUSCODE_DESCRIPTIONS=${LIBOPEN62541_ENABLE_STATUSCODE_DESCRIPTIONS} \
	-DUA_FILE_NS0=${LIBOPEN62541_ENABLE_FULL_NS0} \
	-DBUILD_SHARED_LIBS=${LIBOPEN62541_BUILD_SHARED_LIBS} \
	-DUA_BUILD_EXAMPLES=${LIBOPEN62541_BUILD_EXAMPLES} \
	-DUA_DEBUG=${LIBOPEN62541_BUILD_DEBUG} \
	-DUA_DEBUG_DUMP_PKGS=${LIBOPEN62541_DEBUG_DUMP_PKG} \
"
```

## conf/distro/include/qoriq-baremetal-env.inc
```bitbake
# update kernel configuration
DELTA_KERNEL_DEFCONFIG:append:ls1043ardb = " linux-baremetal-ls104xa.config"
DELTA_KERNEL_DEFCONFIG:append:ls1046ardb = " linux-baremetal-ls104xa.config"
DELTA_KERNEL_DEFCONFIG:append:ls1028ardb = " linux-baremetal-ls1028a.config"
DELTA_KERNEL_DEFCONFIG:append:lx2160a    = " linux-baremetal-lx2160a.config"
DELTA_KERNEL_DEFCONFIG:append:ls1021aiot = " linux-baremetal-ls1021a.config"

# update baremetal dts
KERNEL_DEVICETREE:append:ls1021aiot = " ls1021a-iot-bm.dtb"
KERNEL_DEVICETREE:append:ls1043ardb = " freescale/fsl-ls1043a-rdb-sdk-bm.dtb"
KERNEL_DEVICETREE:append:ls1046ardb = " freescale/fsl-ls1046a-rdb-sdk-bm.dtb"
KERNEL_DEVICETREE:append:ls1028ardb = " freescale/fsl-ls1028a-rdb-sdk-bm.dtb"

# uboot env
UBOOT_BOOT_BAREMETAL_DEFCONFIG:ls1021aiot ?= "ls1021aiot_baremetal_master_defconfig"
UBOOT_BOOT_BAREMETAL_DEFCONFIG:ls1043ardb ?= "ls1043ardb_baremetal_master_defconfig"
UBOOT_BOOT_BAREMETAL_DEFCONFIG:ls1046ardb ?= "ls1046ardb_baremetal_master_defconfig"
UBOOT_BOOT_BAREMETAL_DEFCONFIG:ls1028ardb ?= "ls1028ardb_baremetal_master_defconfig"
UBOOT_BOOT_BAREMETAL_DEFCONFIG:lx2160ardb ?= "lx2160ardb_baremetal_master_defconfig"
UBOOT_BOOT_BAREMETAL_DEFCONFIG:lx2160ardb-rev2 ?= "lx2160ardb_baremetal_master_defconfig"

UBOOT_BOOT_BINARY ?= "u-boot-dtb.bin"
UBOOT_BOOT_BINARY:ls1021aiot ?= "u-boot-with-spl-pbl.bin"

UBOOT_CONFIG = "tfa"
UBOOT_CONFIG[tfa] = "${UBOOT_BOOT_BAREMETAL_DEFCONFIG},,${UBOOT_BOOT_BINARY}"

uboot_boot = "${DEPLOY_DIR_IMAGE}/u-boot.bin-tfa"
uboot = "${DEPLOY_DIR_IMAGE}/u-boot.bin-tfa"

# sai
RCWSD:ls1028ardb = "${@bb.utils.contains('DISTRO_FEATURES', 'sai', \
                    'R_SQPP_0x85bb/rcw_1500_gpu600_sai', \
                    'R_SQPP_0x85bb/rcw_1500_gpu600', d)}"
RCWSD:ls1046ardb = "RR_FFSSPPPH_1133_5559/rcw_1800_gpio2_sdboot"
```

## conf/distro/include/qoriq-real-time-edge-env.inc
```bitbake
require conf/distro/fsl-qoriq.conf
require conf/distro/include/real-time-edge-base.inc

include conf/machine/include/qoriq-wks-base.inc
include conf/distro/include/libopen62541.inc
include conf/distro/include/igh-ethercat.inc

RCWSD:ls1028ardb = "${@bb.utils.contains('DISTRO_FEATURES', 'sai', \
                    'R_SQPP_0x85bb/rcw_1500_gpu600_sai', \
                    'R_SQPP_0x85bb/rcw_1500_gpu600', d)}"
RCWEMMC:ls1046ardb = "RR_FFSSPPPH_1133_5559/rcw_1800_emmcboot"
RCWQSPI:ls1046ardb = "RR_FFSSPPPH_1133_5559/rcw_1600_qspiboot_emmc"

SOC_DEFAULT_IMAGE_FSTYPES:append = " wic.bmap wic.zst tar.zst"
SOC_DEFAULT_IMAGE_FSTYPES:remove = " tar.gz ext2.gz.u-boot ext2.gz wic.bz2"
SOC_DEFAULT_IMAGE_FSTYPES:append:ls1012a = " cpio.gz cpio.gz.u-boot"
SOC_DEFAULT_IMAGE_FSTYPES:remove:ls1012a = " wic.bmap wic.zst tar.zst"
```
